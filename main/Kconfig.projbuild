## main/Kconfig.projbuild
```kconfig
menu "Embewi GPIO"

    config EMBEWI_BUTTON_GPIO
        int "GPIO pour le bouton de test (BOOT sur eval board)"
        default 9 if IDF_TARGET_ESP32C3 || IDF_TARGET_ESP32C6 || IDF_TARGET_ESP32H2
        default 0
        help
            GPIO9  = bouton BOOT sur ESP32-C3, C6, H2.
            GPIO0  = bouton BOOT sur ESP32, S2, S3.
            Ajuster si la carte cible câble le bouton ailleurs.

    config EMBEWI_WS2812_GPIO
        int "GPIO pour la LED WS2812B (app rainbow)"
        default 10
        help
            GPIO libre sur la carte cible. Vérifier que le GPIO choisi
            supporte la sortie RMT (tous les GPIO sur ESP32-C3/S3 ; sur
            ESP32 classique, seuls certains GPIO sont compatibles RMT TX).

endmenu

menu "Embewi Sécurité"

    config EMBEWI_VERIFY_CORE_CERT
        bool "Vérifier le certificat TLS du Core (flux sortants)"
        default n
        help
            DEV (n)  : heartbeat/logs/WS chiffrés mais NON authentifiés
                       (skip_cert_common_name_check). Le device ne vérifie pas
                       l'identité du Core — MITM possible. Pratique sans PKI.

            PROD (y) : le device vérifie le serveur Core contre une CA embarquée
                       (main/core_ca.pem, requis au build). Ferme le MITM.
                       Activé par sdkconfig.defaults.prod.

            La CA embarquée n'est PAS un secret (cert public). Elle doit signer
            le certificat serveur du Core (cert-manager interne, etc.).

    config EMBEWI_ENABLE_IP_FILTER
        bool "Filtrage IP sur l'API inbound (open_fn httpd)"
        default n
        help
            Filtre les connexions entrantes à l'ouverture de chaque session TCP,
            avant tout handler et avant la vérification du token Bearer.

            Source autorisée (par priorité) :
              1. Clé McuConfigMap "allowed_cidr" (ex. "192.168.1.0/24") poussée
                 par le Core via POST /config.
              2. Hôte de ctrl_url (NVS prov) en /32 implicite.

            Si l'hôte est un hostname (pas une IPv4) et qu'aucun allowed_cidr
            n'est défini, le filtre se désactive avec un avertissement de boot.

            DEV (n)  : pas de filtre réseau — seul le token Bearer protège l'API.
            PROD (y) : défense en profondeur, complémentaire au VLAN ESP dédié
                       et à la NetworkPolicy K8s (egress vers le subnet ESP).

endmenu
```

## sdkconfig.defaults
```kconfig
# Embewi Agent — sdkconfig.defaults
# Sélectionne le strict nécessaire à la machine d'état OTA sécurisée.
# Les vrais secrets (signing key, token) ne vont JAMAIS ici.

# --- Partition table -------------------------------------------------------
CONFIG_PARTITION_TABLE_CUSTOM=y
CONFIG_PARTITION_TABLE_CUSTOM_FILENAME="partitions_4mb.csv"
# Pour 8 MB : remplacer par "partitions_8mb.csv" + CONFIG_ESPTOOLPY_FLASHSIZE_8MB=y
CONFIG_ESPTOOLPY_FLASHSIZE_4MB=y

# --- OTA rollback : LE point critique du projet ----------------------------
# Sans ça, une image en PENDING_VERIFY n'est jamais revert automatiquement.
CONFIG_BOOTLOADER_APP_ROLLBACK_ENABLE=y
# Anti-rollback : bloque le downgrade vers une version de sécurité antérieure.
# À activer quand le schéma secure_version est en place (efuse, IRRÉVERSIBLE).
# CONFIG_BOOTLOADER_APP_ANTI_ROLLBACK=y
# CONFIG_BOOTLOADER_APP_SEC_VER_SIZE_EFUSE_FIELD_...

# --- Secure Boot v2 : OBLIGATOIRE MVP (racine de confiance) -----------------
# Décommenter pour build sécurisé. NB : opérations efuse IRRÉVERSIBLES sur device.
# Garder désactivé tant qu'on prototype sur un device sacrifiable.
# CONFIG_SECURE_BOOT=y
# CONFIG_SECURE_BOOT_V2_ENABLED=y
# CONFIG_SECURE_SIGNED_APPS_RSA_SCHEME=y
# Si la table ne tient plus à 0x8000 avec le bootloader signé :
# CONFIG_PARTITION_TABLE_OFFSET=0x10000

# --- Flash encryption : cible si vol physique plausible ---------------------
# CONFIG_SECURE_FLASH_ENC_ENABLED=y

# --- Task Watchdog : backstop du self-check borné ---------------------------
CONFIG_ESP_TASK_WDT_INIT=y
CONFIG_ESP_TASK_WDT_TIMEOUT_S=30

# --- Trace facility : métrique task_hwm_min sur TOUTES les tasks (§5) --------
# Sans ça, le heartbeat reporte seulement le HWM de sa propre task (fallback).
# NB : ne s'applique qu'aux nouveaux sdkconfig (effacer sdkconfig pour l'adopter).
CONFIG_FREERTOS_USE_TRACE_FACILITY=y

# --- HTTPS server (token MVP ; mTLS cible) ----------------------------------
CONFIG_ESP_HTTPS_SERVER_ENABLE=y

# --- Divers -----------------------------------------------------------------
CONFIG_COMPILER_OPTIMIZATION_SIZE=y
CONFIG_FREERTOS_HZ=1000
```

## sdkconfig.defaults.prod
```kconfig
# Embewi Agent — overrides de build PRODUCTION (sécurité)
#
# ⚠️  NE PAS utiliser en dev. Plusieurs de ces options déclenchent des
#     opérations eFuse IRRÉVERSIBLES au premier boot sur un device réel :
#     une fois brûlées, on ne peut plus reflasher librement / lire la flash.
#
# Build prod (s'empile SUR sdkconfig.defaults, ne le remplace pas) :
#   idf.py -DSDKCONFIG_DEFAULTS="sdkconfig.defaults;sdkconfig.defaults.prod" \
#          -B build-prod build
#
# Pré-requis AVANT le premier flash prod (voir docs/embewi-prod-security.md) :
#   - clé de signature Secure Boot générée et gardée HORS dépôt
#   - main/core_ca.pem fourni (CA qui signe le cert serveur du Core)

# ── Secure Boot v2 : racine de confiance (contrat §1, exigence MVP) ───────────
# Le bootloader refuse de booter toute image non/mal signée. Le seul composant
# qui ne peut pas mentir.
CONFIG_SECURE_BOOT=y
CONFIG_SECURE_BOOT_V2_ENABLED=y
CONFIG_SECURE_SIGNED_APPS_RSA_SCHEME=y
# Clé de signature : chemin hors dépôt. Générer avec :
#   idf.py secure-generate-signing-key --version 2 --scheme rsa3072 secure_boot_signing_key.pem
CONFIG_SECURE_BOOT_SIGNING_KEY="secure_boot_signing_key.pem"
# Le bootloader signé grandit → décaler la table de partitions.
CONFIG_PARTITION_TABLE_OFFSET=0x10000

# ── Flash encryption : confidentialité at-rest (vol physique) ─────────────────
# Mode RELEASE = définitif (UART download ne peut plus lire la flash en clair).
CONFIG_SECURE_FLASH_ENC_ENABLED=y
CONFIG_SECURE_FLASH_ENCRYPTION_MODE_RELEASE=y
# Optimisation : brûler les clés Secure Boot + Flash Enc en une passe.
CONFIG_SECURE_BOOT_FLASH_ENC_KEYS_BURN_TOGETHER=y

# Chiffrement NVS : schéma flash-encryption (clés dans la partition nvs_keys,
# chiffrée par la flash enc). Override du défaut C3 = HMAC, qui exigerait de
# brûler une clé HMAC dans un eFuse dédié (étape + risque de collision en plus).
CONFIG_NVS_SEC_KEY_PROTECT_USING_FLASH_ENC=y

# ── Anti-rollback : bloque le downgrade vers une version de sécurité < ────────
# Couplé au champ secure_version de l'app. À incrémenter à chaque correctif sécu.
CONFIG_BOOTLOADER_APP_ANTI_ROLLBACK=y
CONFIG_BOOTLOADER_APP_SECURE_VERSION=0

# ── Surface d'attaque : verrouiller le mode download ROM ──────────────────────
# Secure DL mode : l'UART reste utilisable mais sans lecture flash ni contournement.
# Pour un verrouillage TOTAL (aucune reprise possible), remplacer par :
#   CONFIG_SECURE_DISABLE_ROM_DL_MODE=y
CONFIG_SECURE_ENABLE_SECURE_ROM_DL_MODE=y

# ── Auth des flux sortants : vérifier le cert du Core (cf. main/core_ca.pem) ──
CONFIG_EMBEWI_VERIFY_CORE_CERT=y
```
